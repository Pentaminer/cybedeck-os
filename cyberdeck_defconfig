## cyberdeck_defconfig
```kconfig
# Архитектура платы QEMU ARM VExpress (Cortex-A7)
BR2_arm=y
BR2_cortex_a7=y
BR2_ARM_EABIHF=y
BR2_ARM_FPU_VFPV3D16=y

# Включаем критически важные системные опции (без них графика заблокирована)
BR2_TOOLCHAIN_BUILDROOT_WCHAR=y
BR2_ENABLE_LOCALE=y
BR2_TOOLCHAIN_BUILDROOT_GLIBC=y

# Линукс Ядро (Берем стабильную версию и конфиг vexpress)
BR2_LINUX_KERNEL=y
BR2_LINUX_KERNEL_CUSTOM_VERSION=y
BR2_LINUX_KERNEL_CUSTOM_VERSION_VALUE="6.6.21"
BR2_LINUX_KERNEL_DEFCONFIG="vexpress"
BR2_LINUX_KERNEL_ZIMAGE=y

# Пакеты: Скрипты и Утилиты
BR2_PACKAGE_LUA=y
BR2_PACKAGE_LUA_5_4=y
BR2_PACKAGE_LUASOCKET=y
BR2_PACKAGE_LUAFILESYSTEM=y
BR2_PACKAGE_OPKG=y
BR2_PACKAGE_TMUX=y
BR2_PACKAGE_NANO=y

# Графический стек X11 (Строго актуальный синтаксис 2026.02)
BR2_PACKAGE_XORG7=y
BR2_PACKAGE_XSERVER_XORG_SERVER=y
BR2_PACKAGE_XDRIVER_XF86_VIDEO_FBDEV=y
BR2_PACKAGE_XDRIVER_XF86_INPUT_EVDEV=y

# Интерфейс и Терминал
BR2_PACKAGE_OPENBOX=y
BR2_PACKAGE_XTERM=y
BR2_PACKAGE_XINIT=y

# Таргет файловой системы
BR2_TARGET_ROOTFS_EXT2=y
BR2_TARGET_ROOTFS_EXT2_4=y
```
